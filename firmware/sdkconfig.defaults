## firmware/sdkconfig.defaults
```kconfig
# --- 目标芯片 ---
CONFIG_IDF_TARGET="esp32c3"

# --- Flash 与分区 ---
CONFIG_ESPTOOLPY_FLASHSIZE_8MB=y
CONFIG_ESPTOOLPY_HEADER_FLASHSIZE_UPDATE=n
# 分区表保留受保护的 cardid@0x356000(0x4000),不得移动或覆盖。
CONFIG_PARTITION_TABLE_CUSTOM=y
CONFIG_PARTITION_TABLE_CUSTOM_FILENAME="partitions.csv"
CONFIG_PARTITION_TABLE_FILENAME="partitions.csv"

# --- 编译 ---
# LVGL 软件渲染是主要 CPU 开销,-O2 换取更高的动画帧率(应用分区 3 MB,空间充裕)。
CONFIG_COMPILER_OPTIMIZATION_PERF=y

# --- 控制台:USB-Serial-JTAG(与协议共用)---
CONFIG_ESP_CONSOLE_USB_SERIAL_JTAG=y
CONFIG_ESP_CONSOLE_SECONDARY_NONE=y
# 协议行以 \n 结尾,不让 newlib 把 \n 转成 \r\n。
CONFIG_NEWLIB_STDOUT_LINE_ENDING_LF=y
# 日志与协议共用 USB 串口:应用只输出警告及以上。
CONFIG_LOG_DEFAULT_LEVEL_WARN=y
CONFIG_BOOTLOADER_LOG_LEVEL_WARN=y

# --- 系统 ---
CONFIG_FREERTOS_HZ=1000

# --- LVGL ---
CONFIG_LV_COLOR_DEPTH_16=y
CONFIG_LV_FONT_MONTSERRAT_12=y
CONFIG_LV_FONT_MONTSERRAT_14=y
CONFIG_LV_FONT_MONTSERRAT_20=y
CONFIG_LV_FONT_MONTSERRAT_28=y
CONFIG_LV_FONT_MONTSERRAT_48=y
CONFIG_LV_DEF_REFR_PERIOD=30
# 动画大多由自绘控件完成(每个页面只有少量 LVGL 对象),40 KB 足够。
CONFIG_LV_MEM_SIZE_KILOBYTES=40

# --- 按键(espressif/button)---
# 5 ms 轮询,连续 4 次落在同一电压窗口才认定(20 ms 去抖),滤掉触点抖动与单 ADC 引脚上
# 按键切换时经过其它键电压窗口的瞬态;更长的松开回弹由 ib_keys 的 60 ms 再按锁定挡住。
CONFIG_BUTTON_PERIOD_TIME_MS=5
CONFIG_BUTTON_DEBOUNCE_TICKS=4

# --- 音频 ---
CONFIG_I2S_ISR_IRAM_SAFE=y

# --- Bluetooth LE / NimBLE ---
CONFIG_BT_ENABLED=y
CONFIG_BT_NIMBLE_ENABLED=y
CONFIG_BT_NIMBLE_ROLE_CENTRAL=n
CONFIG_BT_NIMBLE_ROLE_PERIPHERAL=y
CONFIG_BT_NIMBLE_ROLE_BROADCASTER=y
CONFIG_BT_NIMBLE_ROLE_OBSERVER=n
CONFIG_BT_NIMBLE_MAX_CONNECTIONS=1
CONFIG_BT_NIMBLE_HOST_BASED_PRIVACY=n
CONFIG_BT_NIMBLE_NVS_PERSIST=n
CONFIG_BT_NIMBLE_ATT_PREFERRED_MTU=256
CONFIG_BT_NIMBLE_LOG_LEVEL_WARNING=y
```
